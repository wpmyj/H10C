/**
	*	@filename	: uart.c
	*	@author		: Will Fu
	*	@date			: 2016-11-16
	*	@brief		: uart驱动
	*	@maodify	: 2016-11-16 setup
	*	@version	: 1.0
	*/

#include "uart.h"

/******************************************************************************
	函数名称：uart0_init
	函数说明：uart0初始化
	输入参数:	无
	返回参数:	无
******************************************************************************/
void uart0_init(void)
{
	P06_Quasi_Mode;						 	/* 引脚配置 */
	P07_Quasi_Mode;
	InitialUART0_Timer1(9600);
}

/******************************************************************************
	函数名称：uart0_send_byte
	函数说明：uart0发送一个字节
	输入参数:	无
	返回参数:	无
******************************************************************************/
void uart0_send_byte(uint8_t c)
{
	TI = 0;
	SBUF = c;
	while(TI==0);
	err += c;
}

/******************************************************************************
	函数名称：uart0_send_string
	函数说明：uart0发送字符串
	输入参数:	无
	返回参数:	无
******************************************************************************/
void uart0_send_string(uint8_t *dat)
{
	while(*dat != '\0')
	{
		uart0_send_byte(*dat);
		dat++;
	}
}

/******************************************************************************
	函数名称：toHex
	函数功能：只有4位，进来的只可能是0-9,A-F。0-9进来,变30-39
						A-F进来,变41-46
	输入参数：无
	返回参数：校验字
******************************************************************************/
uint8_t toHex(uint8_t t)
{
	if (t < 10)
		t += 0x30;
	else 
		t += (0x41-10);
	
	return t;
}
/* END OF FILE */
